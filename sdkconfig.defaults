## sdkconfig.defaults
```kconfig
CONFIG_AUTOSTART_ARDUINO=y
CONFIG_FREERTOS_HZ=1000
CONFIG_ESPTOOLPY_FLASHSIZE_8MB=y
CONFIG_ESPTOOLPY_FLASHSIZE="8MB"

CONFIG_MBEDTLS_PSK_MODES=y
CONFIG_MBEDTLS_KEY_EXCHANGE_PSK=y
# CONFIG_MBEDTLS_KEY_EXCHANGE_DHE_PSK is not set
# CONFIG_MBEDTLS_KEY_EXCHANGE_ECDHE_PSK is not set
# CONFIG_MBEDTLS_KEY_EXCHANGE_RSA_PSK is not set

CONFIG_EXCALIBUR_SHADOW_STATUS="online"
CONFIG_EXCALIBUR_SHADOW_SOFTWARE_TYPE="stick-s3-asr"
CONFIG_EXCALIBUR_SHADOW_SOFTWARE_VERSION="0.1.0"
CONFIG_EXCALIBUR_SHADOW_HARDWARE_TYPE="M5StickS3"
CONFIG_EXCALIBUR_SHADOW_HARDWARE_VERSION="rev1"
CONFIG_EXCALIBUR_SHADOW_CUSTOM_JSON_STR_LEN=768
CONFIG_EXCALIBUR_SHADOW_PUSH_INTERVAL=60
# CONFIG_EXCALIBUR_ENABLE_DEFAULT_SHADOW_TASK is not set
CONFIG_EXCALIBUR_PROVISIONING_FILESYSTEM_IS_SPIFFS=y
# CONFIG_EXCALIBUR_CLOUD_LOGGING_IS_ENABLED is not set
CONFIG_EXCALIBUR_LOGGING_LEVEL_IS_INFO=y
CONFIG_EXCALIBUR_NUM_MESSAGES_IN_MQTT_BATCH=10
CONFIG_EXCALIBUR_MQTT_BATCH_ELEMENT_SIZE=512
# CONFIG_EXCALIBUR_ENABLE_MQTT_BATCH_TASK is not set
```
